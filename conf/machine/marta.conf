## conf/machine/marta.conf
```bitbake
#@TYPE: Machine
#@NAME: NXP i.MX6Q Marta Board
#@SOC: i.MX6Q
#@DESCRIPTION: Machine configuration for NXP i.MX6Q Marta Board
#@MAINTAINER: Gelco

MACHINEOVERRIDES =. "mx6:mx6q:"

require conf/machine/include/imx6sabresd-common.inc

KERNEL_DEVICETREE = "imx6q-marta.dtb"

UBOOT_MACHINE = "mx6qmarta_config"

PREFERRED_PROVIDER_virtual/bootloader ?= "u-boot-imx"
PREFERRED_PROVIDER_virtual/kernel ?= "linux-imx" 
PREFERRED_PROVIDER_u-boot ?= "u-boot-imx"
PREFERRED_PROVIDER_jpeg = "jpeg"
PREFERRED_VERSION_linux-imx = "4.1.38" 
PREFERRED_VERSION_u-boot-imx = "2016.11"
```
